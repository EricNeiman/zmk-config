#include "esplit.dtsi"

&default_transform {
    col-offset = <7>;
};

kscan0: kscan {
  col-gpios = <&pro_micro 21 GPIO_ACTIVE_HIGH>, // C7
              <&pro_micro 20 GPIO_ACTIVE_HIGH>, // C8
              <&pro_micro 19 GPIO_ACTIVE_HIGH>, // C9
              <&pro_micro 18 GPIO_ACTIVE_HIGH>, // C10
              <&pro_micro 15 GPIO_ACTIVE_HIGH>, // C11
              <&pro_micro 14 GPIO_ACTIVE_HIGH>, // C12
              <&pro_micro 16 GPIO_ACTIVE_HIGH>; // C13
};
