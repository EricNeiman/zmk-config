## boards/shields/esplit/Kconfig.defconfig
```kconfig
if SHIELD_ESPLIT_LEFT

config ZMK_KEYBOARD_NAME
    default "esplit"

config ZMK_SPLIT_ROLE_CENTRAL
    default y

endif


if SHIELD_ESPLIT_LEFT || SHIELD_ESPLIT_RIGHT

config ZMK_SPLIT
    default y

endif
```

## boards/shields/esplit/Kconfig.shield
```kconfig
config SHIELD_ESPLIT_LEFT
  def_bool $(shields_list_contains,esplit_left)

config SHIELD_ESPLIT_RIGHT
  def_bool $(shields_list_contains,esplit_right)
```
